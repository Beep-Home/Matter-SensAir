## main/Kconfig.projbuild
```kconfig
menu "Configure GPIO pins"
    config LED_GPIO
        int "Status LED GPIO"
        default 8
        help
            Define the GPIO to use as status LED the default pin refers to the built-in RGB led present on the esp32H2 dev board.

    config BUTTON_GPIO
        int "Reset button GPIO"
        default 9
        help
            Define the GPIO to use as reset button the default pin refers to the built-in boot button present on the esp32H2 dev board.

    config SENSOR_I2C_SDA_GPIO
        int "I2C sensor SDA GPIO"
        default 22
        help
            GPIO pin used to connect to the SDA of the bme280 sensor.

    config SENSOR_I2C_SCL_GPIO
        int "I2C sensor SCL GPIO"
        default 12
        help
            GPIO pin used to connect to the SCL of the bme280 sensor.
endmenu
```

## sdkconfig.defaults
```kconfig
# General
CONFIG_CHIP_PROJECT_CONFIG="main/chip/device_config.h"

# Flashing and Monitoring Configuration
CONFIG_ESPTOOLPY_BAUD_921600B=y
CONFIG_ESPTOOLPY_BAUD=921600
CONFIG_ESPTOOLPY_COMPRESSED=y
CONFIG_ESPTOOLPY_MONITOR_BAUD_115200B=y
CONFIG_ESPTOOLPY_MONITOR_BAUD=115200
CONFIG_ESPTOOLPY_FLASHSIZE_4MB=y

# Bluetooth
CONFIG_BT_ENABLED=y
CONFIG_BT_NIMBLE_ENABLED=y

# Disable Bluetooth connection reattempt
CONFIG_BT_NIMBLE_ENABLE_CONN_REATTEMPT=n

# Partition Table
CONFIG_PARTITION_TABLE_CUSTOM=y
CONFIG_PARTITION_TABLE_FILENAME="partitions.csv"
CONFIG_PARTITION_TABLE_OFFSET=0xC000

# FreeRTOS
CONFIG_FREERTOS_ENABLE_BACKWARD_COMPATIBILITY=y

# CHIP and OTA
CONFIG_ENABLE_CHIP_SHELL=y
CONFIG_ENABLE_OTA_REQUESTOR=n

# Network
CONFIG_LWIP_HOOK_IP6_ROUTE_DEFAULT=y
CONFIG_LWIP_HOOK_ND6_GET_GW_DEFAULT=y

# Disable Wi-Fi SoftAP support
CONFIG_ESP_WIFI_SOFTAP_SUPPORT=n

# Security
CONFIG_ESP_SECURE_CERT_DS_PERIPHERAL=n
CONFIG_LIBSODIUM_USE_MBEDTLS_SHA=y
CONFIG_MBEDTLS_HKDF_C=y
```

## sdkconfig.defaults.esp32c6
```kconfig
# General
CONFIG_IDF_TARGET="esp32c6"

# GPIO and Sensor
CONFIG_SENSOR_I2C_SDA_GPIO=6
CONFIG_SENSOR_I2C_SCL_GPIO=7
CONFIG_LED_GPIO=8
CONFIG_BUTTON_GPIO=9

# Bluetooth (NIMBLE)
CONFIG_BT_NIMBLE_EXT_ADV=n
CONFIG_BT_NIMBLE_TRANSPORT_EVT_SIZE=70
CONFIG_USE_BLE_ONLY_FOR_COMMISSIONING=n

# OpenThread
CONFIG_OPENTHREAD_ENABLED=y
CONFIG_OPENTHREAD_SRP_CLIENT=y
CONFIG_OPENTHREAD_DNS_CLIENT=y
CONFIG_OPENTHREAD_LOG_LEVEL_DYNAMIC=n
CONFIG_OPENTHREAD_LOG_LEVEL_NOTE=y
CONFIG_OPENTHREAD_CLI=n

# Network
CONFIG_LWIP_IPV6_AUTOCONFIG=n

# Thread
CONFIG_ENABLE_MATTER_OVER_THREAD=y

# LwIP
CONFIG_LWIP_IPV6_NUM_ADDRESSES=8
CONFIG_LWIP_MULTICAST_PING=y

# MDNS
CONFIG_USE_MINIMAL_MDNS=n
CONFIG_ENABLE_EXTENDED_DISCOVERY=y

# Wi-Fi
CONFIG_ENABLE_WIFI_STATION=n
CONFIG_ENABLE_WIFI_AP=n

# Subscription Management
CONFIG_ENABLE_PERSIST_SUBSCRIPTIONS=n

# MRP (Mesh Routing Protocol)
CONFIG_MRP_LOCAL_ACTIVE_RETRY_INTERVAL_FOR_THREAD=5000
CONFIG_MRP_LOCAL_IDLE_RETRY_INTERVAL_FOR_THREAD=5000
CONFIG_MRP_RETRY_INTERVAL_SENDER_BOOST_FOR_THREAD=5000
CONFIG_MRP_MAX_RETRANS=3
```

## sdkconfig.defaults.esp32c6_wifi
```kconfig
# General
CONFIG_IDF_TARGET="esp32c6"

# GPIO and Sensor
CONFIG_SENSOR_I2C_SDA_GPIO=6
CONFIG_SENSOR_I2C_SCL_GPIO=7
CONFIG_LED_GPIO=8
CONFIG_BUTTON_GPIO=9

# Bluetooth (NIMBLE)
CONFIG_BT_NIMBLE_EXT_ADV=n
CONFIG_USE_BLE_ONLY_FOR_COMMISSIONING=y

# Network
CONFIG_LWIP_IPV6_AUTOCONFIG=y

# LwIP
CONFIG_LWIP_IPV6_NUM_ADDRESSES=6

# MDNS
CONFIG_USE_MINIMAL_MDNS=y
CONFIG_ENABLE_EXTENDED_DISCOVERY=y

# Wi-Fi
CONFIG_ENABLE_WIFI_STATION=y
CONFIG_ENABLE_WIFI_AP=n
```

## sdkconfig.defaults.esp32s3
```kconfig
# General
CONFIG_IDF_TARGET="esp32s3"

# GPIO and Sensor
CONFIG_SENSOR_I2C_SDA_GPIO=35
CONFIG_SENSOR_I2C_SCL_GPIO=36
CONFIG_LED_GPIO=47
CONFIG_BUTTON_GPIO=0

# Bluetooth (NIMBLE)
CONFIG_BT_ENABLED=y
CONFIG_BT_NIMBLE_ENABLED=y

# Network
CONFIG_LWIP_IPV6_AUTOCONFIG=y

# Thread
CONFIG_ENABLE_MATTER_OVER_THREAD=n

# LwIP
CONFIG_LWIP_IPV6_NUM_ADDRESSES=6
```
